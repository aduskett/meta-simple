## conf/layer.conf
```bitbake
# We have a conf and classes directory, add to BBPATH
BBPATH .= ":${LAYERDIR}"

# We have recipes-* directories, add to BBFILES
BBFILES += "${LAYERDIR}/recipes-*/*/*.bb \
        ${LAYERDIR}/recipes-*/*/*.bbappend"

BBFILE_COLLECTIONS += "meta-simple"
BBFILE_PATTERN_meta-simple = "^${LAYERDIR}"
BBFILE_PRIORITY_meta-simple = "100"

# This should only be incremented on significant changes that will
# cause compatibility issues with other layers
LAYERVERSION_meta-simple = "1"

LAYERDEPENDS_meta-simple = " \
    core \
"

LAYERSERIES_COMPAT_meta-simple = "whinlatter"
```

## meta-simpleimage/conf/distro/include/simple-coreutils.inc
```bitbake
IMAGE_INSTALL:append = " coreutils"

PREFERRED_PROVIDER_coreutils = "coreutils"
PREFERRED_PROVIDER_virtual/base-utils = "packagegroup-core-base-utils"
SKIP_RECIPE[uutils-coreutils] = "Don't build this"
VIRTUAL-RUNTIME_base-utils-hwclock = "util-linux-hwclock"
VIRTUAL-RUNTIME_base-utils = "packagegroup-core-base-utils"
```

## meta-simpleimage/conf/distro/include/simple-dnf.inc
```bitbake
IMAGE_INSTALL:append = " dnf"

PACKAGE_CLASSES = "package_rpm"
IMAGE_FEATURES:append = "package-management"
```

## meta-simpleimage/conf/distro/include/simple-initramfs-systemd-dracut.inc
```bitbake
DISTRO_FEATURES:append = " efi systemd"
IMAGE_INSTALL:append = " systemd"
INIT_MANAGER = "none"

INITRAMFS_IMAGE_BUNDLE = "0"
INITRAMFS_IMAGE = "simple-initramfs-systemd-dracut"

#256M
INITRAMFS_MAXSIZE = "262144"

IMAGE_FSTYPES = "wic"
WKS_FILE = "simple-image-with-dracut-initramfs.wks"
```

## meta-simpleimage/conf/distro/include/simple-systemd.inc
```bitbake
DISTRO_FEATURES:append = " systemd"

IMAGE_INSTALL:append = " systemd"

# Use systemd with journald for logging.
INIT_MANAGER = "systemd"
VIRTUAL-RUNTIME_syslog ?= ""
VIRTUAL-RUNTIME_base-utils-syslog ?= ""
```

## meta-simpleimage/conf/distro/simpleimage.conf
```bitbake
DISTRO = "simpleimage"
DISTRO_NAME = "Simple Image"
DISTRO_CODENAME = "whinlatter"

# Bump this every time OpenEmbedded is updated!
DISTRO_VERSION = "1.0"
SDK_VENDOR = "-simpleimagesdk"
SDK_VERSION := "${@'${DISTRO_VERSION}'.replace('snapshot-${METADATA_REVISION}','snapshot')}"
SDK_VERSION[vardepvalue] = "${SDK_VERSION}"

MAINTAINER = "Adam Duskett <adam.duskett@amarulasolutions.com>"

TARGET_VENDOR = "-simpleimage"

# New ${DISTRO}-<version> setting for sanity checks.
# Increment version number each time the layer settings
# are changed.
REQUIRED_BBLAYERS_CONF_VERSION = "${DISTRO}-1"

LOCALCONF_VERSION = "2"

PACKAGE_CLASSES ?= "package_ipk"

SANITY_TESTED_DISTROS ?= " \
  fedora-42 \n \
  fedora-43 \n \
  debian-11 \n \
  debian-12 \n \
  debian-13 \n \
"

# Set features we want. Also disables any features not explicitly mentioned.
DISTRO_FEATURES = " \
  ipv4 \
  ipv6 \
  usrmerge \
  zeroconf \
"

IMAGE_FSTYPES ?= "tar ext4 wic"
WKS_FILE ?= "simple-image.wks"

QB_DEFAULT_FSTYPE = "ext4"

require conf/distro/include/cve-extra-exclusions.inc
require conf/distro/include/lto.inc
require conf/distro/include/no-static-libs.inc
require conf/distro/include/rust_security_flags.inc
require conf/distro/include/security_flags.inc
require conf/distro/include/yocto-space-optimize.inc
require conf/distro/include/yocto-uninative.inc

# require conf/distro/include/simple-coreutils.inc
# require conf/distro/include/simple-systemd.inc
# require conf/distro/include/simple-dnf.inc
# require conf/distro/include/simple-initramfs-systemd-dracut.inc

INHERIT += "uninative"
```

## meta-simpleimage/conf/layer.conf
```bitbake
# We have a conf and classes directory, add to BBPATH
BBPATH .= ":${LAYERDIR}"

# We have recipes-* directories, add to BBFILES
BBFILES += "${LAYERDIR}/recipes-*/*/*.bb \
            ${LAYERDIR}/recipes-*/*/*.bbappend"

BBFILE_COLLECTIONS += "simpleimage-layer"
BBFILE_PATTERN_simpleimage-layer = "^${LAYERDIR}/"
BBFILE_PRIORITY_simpleimage-layer = "9"

LAYERDEPENDS_simpleimage-layer = "core"
LAYERSERIES_COMPAT_simpleimage-layer = "whinlatter"
```

## meta-simpleimage/wic/simple-image-with-dracut-initramfs.wks
```
bootloader --ptable gpt
part /boot --source bootimg-efi --sourceparams="loader=grub-efi,initrd=simple-initramfs-systemd-dracut-${MACHINE}.cpio" --ondisk sda --label efi --active --align 1024 --size 512M
part / --source rootfs --fstype=ext4 --ondisk sda --label rootfs --align 1024
part /data --source extra_partition --fstype=ext4 --ondisk sda --label data --align 1024 --size 128M
```

## meta-simpleimage/wic/simple-image.wks
```
bootloader --ptable gpt
part / --source rootfs --fstype=ext4 --ondisk sda --label rootfs --align 1024
part /data --source extra_partition --fstype=ext4 --ondisk sda --label data --align 1024 --size 128M
```
